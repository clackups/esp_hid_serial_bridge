## main/Kconfig.projbuild
```kconfig
menu "HID_SERIAL_BRIDGE Config"      
    config BRIDGE_PRODUCT_NAME
        string "USB product name"
        default "HID Serial Bridge"
        help
            Product name string shown in USB device descriptor

	config MODULE_USEKEYBOARD
		bool "Enable BLE-HID keyboard (UNUSED, mouse is always enabled)"
		default y
		help
			Enable the Keyboard interface for Bluetooth.
			
	config MODULE_USEMOUSE
		depends on MODULE_USEKEYBOARD
		bool "Enable BLE-HID mouse (UNUSED, kbd is always enabled)"
		default y
		help
			Enable the Mouse interface for Bluetooth.
			
	config MODULE_USEABSOLUTEMOUSE
		depends on MODULE_USEMOUSE
		bool "Use absolute mouse instead of classic relative mouse (UNUSED)"
		default n
		help
			If enabled, the normal relative mouse is replaced with an
			absolute mouse descriptor. Please note, that a different mouse
			input data is used if enabled (we need int16_t for x and y).
			
	config MODULE_USEJOYSTICK
		depends on MODULE_USEMOUSE
		bool "Enable BLE-HID joystick"
		default y
		help
			Enable the Joystick interface for Bluetooth.
			
	config MODULE_BT_PAIRING
		bool "Disable pairing by default, enabled by command"
		default n
		help
			If enabled, the module denies pairing requests by default.
			It is possible to enable the pairing by sending the pairing en-/disable command
			via the serial interface.
endmenu
```

## sdkconfig.defaults
```kconfig
CONFIG_IDF_TARGET="esp32s3"

CONFIG_LOG_VERSION_1=y
CONFIG_LOG_VERSION=1
CONFIG_LOG_DEFAULT_LEVEL_ERROR=y
CONFIG_LOG_DEFAULT_LEVEL=1
CONFIG_LOG_MAXIMUM_EQUALS_DEFAULT=y
CONFIG_LOG_MAXIMUM_LEVEL=1

CONFIG_BT_ENABLED=y
CONFIG_BT_BLE_42_FEATURES_SUPPORTED=y


CONFIG_TINYUSB_DESC_USE_ESPRESSIF_VID=n
CONFIG_TINYUSB_DESC_USE_DEFAULT_PID=n
CONFIG_TINYUSB_DESC_CUSTOM_VID=0x1209
CONFIG_TINYUSB_DESC_CUSTOM_PID=0xbbd1
CONFIG_TINYUSB_DESC_BCD_DEVICE=0x0100
CONFIG_TINYUSB_DESC_MANUFACTURER_STRING="clackups"
CONFIG_TINYUSB_DESC_PRODUCT_STRING="HID Serial Bridge"
CONFIG_TINYUSB_DESC_SERIAL_STRING="000001"
CONFIG_TINYUSB_CDC_ENABLED=y

CONFIG_TINYUSB_CDC_RX_BUFSIZE=10000
```
